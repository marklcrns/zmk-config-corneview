## config/west.yml
```yaml
manifest:
  defaults:
    revision: ead91ca094c6cd778574f73b9ae011ddab611c66
  remotes:
    - name: zmkfirmware
      url-base: https://github.com/zmkfirmware
  projects:
    - name: zmk
      remote: zmkfirmware
      revision: ead91ca094c6cd778574f73b9ae011ddab611c66
      import: app/west.yml
  self:
    path: config
```
